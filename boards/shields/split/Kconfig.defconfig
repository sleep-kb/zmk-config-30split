## boards/shields/split/Kconfig.defconfig
```kconfig
if SHIELD_SPLIT_LEFT


  config ZMK_KEYBOARD_NAME
    default "30split"

  config ZMK_SPLIT_ROLE_CENTRAL
    default y

endif

if SHIELD_SPLIT_LEFT || SHIELD_SPLIT_RIGHT

  config ZMK_SPLIT
    default y

  config ZMK_BLE
    default y

endif
```

## boards/shields/split/Kconfig.shield
```kconfig
#config SHIELD_DONGLE
#    def_bool $(shields_list_contains,split_dongle)

config SHIELD_SPLIT_LEFT
    def_bool $(shields_list_contains,split_left)

config SHIELD_SPLIT_RIGHT
    def_bool $(shields_list_contains,split_right)
```
